## evals/fixtures/zephyr-logger/Kconfig
```kconfig
menu "zlogger"

config ZL_RINGBUF_LOG
	bool "Sample ring buffer"
	help
	  Fixed-capacity ring buffer of sensor samples with a configurable
	  full-buffer policy (reject new or drop oldest).

config ZL_SENSOR_READER
	bool "Sensor reader"
	select ZL_RINGBUF_LOG
	help
	  Reads samples through a small HAL and appends them to a
	  sample ring buffer.

endmenu
```

## evals/fixtures/zephyr-logger/tests/drivers/sensor_reader/testcase.yaml
```yaml
tests:
  drivers.sensor_reader:
    tags: sensor_reader
    platform_allow:
      - native_sim
      - native_sim/native/64
    integration_platforms:
      - native_sim
```

## evals/fixtures/zephyr-logger/tests/lib/ringbuf_log/testcase.yaml
```yaml
tests:
  lib.ringbuf_log:
    tags: ringbuf_log
    platform_allow:
      - native_sim
      - native_sim/native/64
    integration_platforms:
      - native_sim
```
